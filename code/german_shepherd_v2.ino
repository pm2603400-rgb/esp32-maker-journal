/*
 * 德國牧羊犬 OLED 動畫（AI 繪圖版）
 * 硬體：ESP32 + 1.3 吋 OLED (SH1106, I2C)
 * 接線：VCC→3V3、GND→GND、SCL→D22、SDA→D21
 *
 * 狗狗圖片來自 AI 畫的 sprite sheet，已轉成 OLED 點陣圖放在檔案最下方
 * 預設「白底黑線」，看起來跟原圖一樣；想改回黑底，把 WHITE_BG 改成 false
 * 動作：走路(4格)、奔跑(4格)、坐下喘氣(2格)、叫(2格)、低頭聞(2格)、睡覺(2格)
 *
 * 會隨機輪播：
 *  [散步]   站著張望、偶爾跑到別的位置，偶爾叫「汪!」（沒有走路動作，移動都用跑的）
 *  [嗅聞]   低頭聞、轉身換邊聞，聞到東西抬頭叫
 *  [撿球]   球從畫面外飛進來 → 狂奔過去 → 低頭咬 → 叼回中間 → 坐下放球 → 叫
 *  [坐下休息] 坐著吐舌頭喘氣
 *  [睡覺]   坐下 → 趴著睡、冒 Zzz → 驚醒
 *  [跑出去] 衝出畫面 → 從另一邊探頭張望 → 走進來
 *  按板子上的 BOOT 鍵 = 丟球給牠
 *
 * 【WiFi 無線更新 OTA】
 *  1. 把下面的 WIFI_SSID、WIFI_PASS 改成你的手機熱點（2.4GHz）
 *  2. 第一次用 USB 線上傳；之後在「工具 → 連接埠」選 esp32-dog 無線上傳，密碼 OTA_PASS
 *  ※ 之後每一支程式都要保留 OTA 這段
 *
 * 若畫面右側有雜點，把下面的 SH1106 改成 SSD1306
 */

#include <U8g2lib.h>
#include <Wire.h>
#include <math.h>
#include <WiFi.h>
#include <ArduinoOTA.h>

// ===== WiFi 設定（改成你自己的）=====
const char* WIFI_SSID = "你的WiFi名稱";
const char* WIFI_PASS = "你的WiFi密碼";
const char* OTA_NAME  = "esp32-dog";
const char* OTA_PASS  = "1234";

U8G2_SH1106_128X64_NONAME_F_HW_I2C u8g2(U8G2_R0, U8X8_PIN_NONE);

const bool WHITE_BG = true;      // true = 白底黑線（像原圖）、false = 黑底白線

// =====================================================================
//  型別定義（Arduino 規定要放在所有函式前面）
// =====================================================================
struct Sprite {
  uint8_t w, h;        // 圖片寬高
  uint8_t ax;          // 身體中心（圖片裡的 x）
  int8_t  mx, my;      // 嘴巴位置（相對身體中心、腳底）
  const unsigned char* bits;
};
struct Ball { float x, y, vx, vy; bool active, held; };
enum Act   { A_WALK, A_RUN, A_SIT, A_BARK, A_SNIFF, A_SLEEP, A_STAND };
enum Scene { S_WANDER, S_SNIFF, S_FETCH, S_SIT, S_SLEEP, S_RUN_OFF, S_EMPTY, S_PEEK };

extern const Sprite SPRITES[];
extern const int WANG_W, WANG_H;
extern const unsigned char WANG_bits[];

// 每個動作在 SPRITES 裡的起始位置、格數
const uint8_t ACT_START[] = { 0, 4, 8, 10, 12, 14, 10 };
const uint8_t ACT_COUNT[] = { 4, 4, 2,  2,  2,  2,  1 };

// =====================================================================
//  狀態
// =====================================================================
const int GROUND = 62;          // 腳底高度
float dogX = 64, dogVX = 0, walkDist = 0;
int   face = 1, faceLock = 0;
Act   act = A_STAND;
int   curSprite = 10;
unsigned long barkUntil = 0;
char  markC = 0; unsigned long markUntil = 0;
Ball  ball = {0, 0, 0, 0, false, false};

Scene scene = S_WANDER;
unsigned long sceneStart = 0, sceneStartAll = 0, sceneDur = 10000;
int   sceneStep = 0, exitSide = 1, approach = 1;
float goalX = 64;
unsigned long nextGoal = 0, nextBark = 0;
unsigned long frame = 0;
bool  lastBtn = HIGH;

// =====================================================================
//  基本繪圖
// =====================================================================
void px(int x, int y) { if (x >= 0 && x < 128 && y >= 0 && y < 64) u8g2.drawPixel(x, y); }

void line(int x0, int y0, int x1, int y1) {
  int dx = abs(x1 - x0), sx = x0 < x1 ? 1 : -1;
  int dy = -abs(y1 - y0), sy = y0 < y1 ? 1 : -1;
  int err = dx + dy;
  while (true) {
    px(x0, y0);
    if (x0 == x1 && y0 == y1) break;
    int e2 = 2 * err;
    if (e2 >= dy) { err += dy; x0 += sx; }
    if (e2 <= dx) { err += dx; y0 += sy; }
  }
}

void disc(int x0, int y0, int r) {
  for (int j = -r; j <= r; j++)
    for (int i = -r; i <= r; i++)
      if (i * i + j * j <= r * r + r) px(x0 + i, y0 + j);
}

void blit(const unsigned char* bits, int w, int h, int x, int y) {
  int bpr = (w + 7) / 8;
  for (int j = 0; j < h; j++)
    for (int i = 0; i < w; i++)
      if (pgm_read_byte(&bits[j * bpr + i / 8]) & (1 << (i % 8))) px(x + i, y + j);
}

void mark(int x, int y, char c) {
  if (c == '!') {
    line(x, y, x, y + 3); line(x + 1, y, x + 1, y + 3);
    px(x, y + 5); px(x + 1, y + 5);
  } else if (c == '?') {
    px(x, y + 1); px(x + 1, y); px(x + 2, y); px(x + 3, y + 1);
    px(x + 3, y + 2); px(x + 2, y + 3); px(x + 1, y + 4); px(x + 1, y + 6);
  }
}

void zLetter(int x, int y, int s) {
  line(x, y, x + s, y); line(x + s, y, x, y + s); line(x, y + s, x + s, y + s);
}

// 畫一張狗狗圖：x = 身體中心、y = 腳底，face = -1 時左右翻轉
void drawSprite(const Sprite& s, int x, int y, int f) {
  int bpr = (s.w + 7) / 8;
  int top = y - s.h + 1;
  for (int j = 0; j < s.h; j++) {
    for (int i = 0; i < s.w; i++) {
      if (pgm_read_byte(&s.bits[j * bpr + i / 8]) & (1 << (i % 8))) {
        int sx = f > 0 ? x - s.ax + i : x + s.ax - i;
        px(sx, top + j);
      }
    }
  }
}

// =====================================================================
//  狗狗
// =====================================================================
int pickSprite(unsigned long now) {
  int n = 0;
  switch (act) {
    case A_WALK:  n = (int)(walkDist / 5) % 4; break;
    case A_RUN:   n = (int)(walkDist / 8) % 4; break;
    case A_SIT:   n = (now / 300) % 2; break;                       // 喘氣
    case A_BARK:  n = now < barkUntil ? (now / 150) % 2 : 0; break; // 嘴巴一開一合
    case A_SNIFF: n = (now / 250) % 2; break;
    case A_SLEEP: n = (now / 900) % 2; break;                       // 呼吸
    default:      n = 0; break;
  }
  return ACT_START[act] + n;
}

float mouthX() { return dogX + face * SPRITES[curSprite].mx; }
float mouthY() { return GROUND + SPRITES[curSprite].my; }

void drawDog(unsigned long now) {
  const Sprite& s = SPRITES[curSprite];
  int bobY = 0;                               // 走路時身體一上一下，讓步伐更明顯
  if (act == A_WALK) bobY = ((int)(walkDist / 5) % 2);
  if (act == A_RUN)  bobY = ((int)(walkDist / 8) % 2) * 2;
  drawSprite(s, (int)dogX, GROUND - bobY, face);

  int headX = (int)(dogX + face * (s.mx - 6));
  int topY = GROUND - s.h;
  if (markC && now < markUntil) mark(headX, max(0, topY - 9), markC);

  if (now < barkUntil) {                      // 「汪!」泡泡
    int bx = face > 0 ? (int)mouthX() + 3 : (int)mouthX() - 25;
    int by = topY - 8;
    if (bx < 0) bx = 0; if (bx > 105) bx = 105; if (by < 0) by = 0;
    u8g2.setDrawColor(0); u8g2.drawBox(bx, by, 22, 15); u8g2.setDrawColor(1);
    u8g2.drawRFrame(bx, by, 22, 15, 3);
    blit(WANG_bits, WANG_W, WANG_H, bx + 2, by + 2);
    line(bx + 17, by + 3, bx + 17, by + 9); line(bx + 18, by + 3, bx + 18, by + 9);
    px(bx + 17, by + 11); px(bx + 18, by + 11);
  }
  if (act == A_SLEEP) {                       // Zzz
    for (int k = 0; k < 3; k++) {
      float t = fmodf(frame * 0.02f + k / 3.0f, 1.0f);
      int zx = headX + face * (4 + (int)(t * 10)), zy = topY - 2 - (int)(t * 18);
      zLetter(zx, zy, 2 + (int)(t * 3));
    }
  }
}

void bark(unsigned long ms) { barkUntil = millis() + ms; }
void setMark(char c, unsigned long ms) { markC = c; markUntil = millis() + ms; }

bool walkTo(float goal, float speed) {
  float d = goal - dogX;
  float want = 0;
  if (fabsf(d) > 2) want = (d > 0 ? 1 : -1) * speed;
  if (fabsf(d) < 12) want *= fabsf(d) / 12;
  dogVX += (want - dogVX) * 0.12f;
  if (want == 0 && fabsf(dogVX) < 0.25f) dogVX = 0;   // 停就停，不要慢慢滑
  return fabsf(d) <= 2.5f && fabsf(dogVX) < 0.2f;
}

void updateMotion() {
  dogX += dogVX;
  if (dogVX > 0.1f) face = 1;
  if (dogVX < -0.1f) face = -1;
  if (faceLock) face = faceLock;
  walkDist += fabsf(dogVX);
}

// 依照速度自動選走 / 跑 / 站
Act moveAct(bool barking) {
  float sp = fabsf(dogVX);
  if (sp > 0.12f) return A_RUN;                    // 不走路：要移動就用跑的
  return barking ? A_BARK : A_STAND;
}

// =====================================================================
//  球
// =====================================================================
void throwBall() {
  int s = random(0, 2) ? 1 : -1;
  ball.x = s > 0 ? 130 : -2;
  ball.y = 26;
  ball.vx = -s * (random(14, 24) / 10.0f);
  ball.vy = -1.5f;
  ball.active = true; ball.held = false;
}

void updateBall() {
  if (!ball.active) return;
  if (ball.held) { ball.x = mouthX() + face; ball.y = mouthY() + 1; return; }
  ball.vy += 0.25f;
  ball.x += ball.vx; ball.y += ball.vy;
  if (ball.y > GROUND - 2) {
    ball.y = GROUND - 2;
    ball.vy = -ball.vy * 0.55f;
    if (fabsf(ball.vy) < 0.6f) ball.vy = 0;
    ball.vx *= 0.92f;
  }
  if (ball.x < 3)   { ball.x = 3;   ball.vx = fabsf(ball.vx) * 0.6f; }
  if (ball.x > 124) { ball.x = 124; ball.vx = -fabsf(ball.vx) * 0.6f; }
}

void drawBall() {
  if (!ball.active) return;
  int x = (int)ball.x, y = (int)ball.y;
  disc(x, y, 2);
  u8g2.setDrawColor(0); px(x, y); u8g2.setDrawColor(1);
}

// =====================================================================
//  劇情
// =====================================================================
void startScene(Scene s, unsigned long now) {
  scene = s; sceneStart = now; sceneStartAll = now; sceneStep = 0; faceLock = 0;
  switch (s) {
    case S_WANDER:  sceneDur = random(9000, 14000); nextGoal = now; break;
    case S_SNIFF:   sceneDur = random(7000, 10000); nextGoal = now + random(1200, 2400); break;
    case S_FETCH:   throwBall(); setMark('!', 800); break;
    case S_SIT:     sceneDur = random(5000, 8000); nextBark = now + random(1500, 4000); break;
    case S_SLEEP:   sceneDur = 9000; break;
    case S_RUN_OFF: exitSide = dogX < 64 ? -1 : 1; break;
    case S_EMPTY:   break;
    case S_PEEK:    face = exitSide > 0 ? 1 : -1; dogVX = 0; break;
  }
}

void nextScene(unsigned long now) {
  const Scene opts[] = { S_WANDER, S_SNIFF, S_FETCH, S_SIT, S_SLEEP, S_RUN_OFF };
  Scene s;
  do { s = opts[random(0, 6)]; } while (s == scene);
  startScene(s, now);
}

void updateScene(unsigned long now) {
  unsigned long t = now - sceneStart;
  bool barking = now < barkUntil;

  switch (scene) {

    case S_WANDER: {
      if (now > nextGoal) {                        // 偶爾跑到另一個位置
        float g = random(34, 95);
        if (fabsf(g - dogX) > 25) goalX = g;
        nextGoal = now + random(3000, 6000);
      }
      bool arrived = walkTo(goalX, 1.8f);
      act = moveAct(barking);
      if (arrived && random(0, 350) == 0) face = -face;        // 回頭張望
      if (arrived && !barking && random(0, 450) == 0) bark(700);
      if (t > sceneDur) nextScene(now);
      break;
    }

    case S_SNIFF: {                                   // 聞一聞 → 走幾步 → 再聞
      if (sceneStep == 0) {                            // 停下來低頭聞
        walkTo(dogX, 0);
        dogVX *= 0.6f;                                 // 很快停住，不會滑行
        act = A_SNIFF;
        if (random(0, 300) == 0) setMark('?', 700);
        if (now > nextGoal) {                          // 聞一聞轉身換邊聞
          if (random(0, 2)) face = -face;
          nextGoal = now + random(1200, 2400);
        }
      }
      if (sceneStep < 2 && t > sceneDur) { sceneStep = 2; sceneStart = now; setMark('!', 600); }
      if (sceneStep == 2) {                            // 聞到了！抬頭叫
        walkTo(dogX, 0);
        act = A_BARK;
        if (t > 300 && t < 340) bark(900);
        if (t > 1800) nextScene(now);
      }
      break;
    }

    case S_FETCH: {
      const float REACH = 24;                          // 低頭時嘴巴到身體中心的距離
      if (sceneStep == 0) {                            // 看球飛進來
        walkTo(dogX, 0);
        act = A_STAND;
        faceLock = ball.x > dogX ? 1 : -1;
        if (t > 500) { sceneStep = 1; approach = faceLock; }
      } else if (sceneStep == 1) {                     // 衝過去
        if ((ball.x - dogX) * approach < 0 && fabsf(ball.vx) < 0.3f) approach = -approach;
        float goal = constrain(ball.x - approach * REACH, -10.0f, 138.0f);
        float off = (goal - dogX) * approach;             // >0 要往前、<0 要往後
        if (off < 0 && off > -12) goal = dogX;            // 球只差一點點在後面：不倒退，直接低頭咬
        walkTo(goal, 2.2f);
        act = moveAct(false);
        faceLock = fabsf(goal - dogX) < 15 ? approach : 0;
        if (fabsf(dogX - goal) < 4 && fabsf(dogVX) < 0.3f && fabsf(ball.vx) < 0.3f && ball.y >= GROUND - 3) {
          sceneStep = 2; sceneStart = now; faceLock = approach;
        }
      } else if (sceneStep == 2) {                     // 低頭咬
        walkTo(dogX, 0);
        act = A_SNIFF;
        if (t > 450) { ball.held = true; faceLock = 0; sceneStep = 3; }
      } else if (sceneStep == 3) {                     // 叼回中間
        bool arrived = walkTo(64, 1.8f);
        act = moveAct(false);
        if (arrived) { sceneStep = 4; sceneStart = now; }
      } else if (sceneStep == 4) {                     // 坐下、放球、叫
        walkTo(dogX, 0);
        act = t < 1100 ? A_SIT : A_BARK;
        if (t > 600 && ball.held) { ball.held = false; ball.vx = face * 0.8f; ball.vy = -1; }
        if (t > 1100 && t < 1140) bark(800);
        if (t > 2600) act = A_SIT;
        if (t > 3600) { ball.active = false; nextScene(now); }
      }
      if (now - sceneStartAll > 25000) { ball.active = false; nextScene(now); }
      break;
    }

    case S_SIT: {
      walkTo(dogX, 0);
      act = barking ? A_BARK : A_SIT;
      if (now > nextBark) { bark(800); nextBark = now + 99999; }
      if (t > sceneDur) nextScene(now);
      break;
    }

    case S_SLEEP: {
      walkTo(dogX, 0);
      if (t < 1200)      act = A_SIT;
      else if (t < 7500) act = A_SLEEP;
      else {
        if (t < 7550) setMark('!', 700);
        act = A_STAND;
      }
      if (t > sceneDur) nextScene(now);
      break;
    }

    case S_RUN_OFF: {
      walkTo(exitSide > 0 ? 220 : -92, 2.4f);
      act = moveAct(false);
      if (dogX > 172 || dogX < -44) startScene(S_EMPTY, now);
      break;
    }

    case S_EMPTY:
      if (t > 1200) startScene(S_PEEK, now);
      break;

    case S_PEEK: {                                    // 從另一邊探頭
      float edge = exitSide > 0 ? 0 : 128;
      float nose = SPRITES[ACT_START[A_STAND]].mx;
      float hidden = edge - face * (nose + 4);          // 完全看不到
      float peek   = edge - face * (nose - 16);         // 只露出頭
      float p;
      if (t < 600)       p = t / 600.0f;
      else if (t < 1600) p = 1;
      else if (t < 2000) p = 1 - (t - 1600) / 400.0f * 0.8f;   // 縮回去
      else if (t < 2600) p = 0.2f + (t - 2000) / 600.0f * 0.8f; // 再探出來
      else               p = 1;
      if (t < 3200) {
        dogX = hidden + (peek - hidden) * p;
        dogVX = 0;
        act = A_STAND;
        if (t > 700 && t < 740) setMark('?', 800);
      } else {
        bool arrived = walkTo(64, 1.8f);
        act = moveAct(now < barkUntil);
        if (arrived) { bark(700); startScene(S_WANDER, now); }
      }
      break;
    }
  }
}

// =====================================================================
//  WiFi 無線更新（OTA）
// =====================================================================
bool otaReady = false;

void drawOtaProgress(int pct) {
  u8g2.clearBuffer();
  u8g2.setFont(u8g2_font_6x10_tr);
  u8g2.drawStr(22, 18, "OTA Updating...");
  u8g2.drawFrame(14, 28, 100, 12);
  u8g2.drawBox(16, 30, pct * 96 / 100, 8);
  char buf[12];
  snprintf(buf, sizeof(buf), "%d%%", pct);
  u8g2.drawStr(54, 56, buf);
  u8g2.sendBuffer();
}

void setupWiFi() {
  WiFi.mode(WIFI_STA);
  WiFi.setHostname(OTA_NAME);
  WiFi.begin(WIFI_SSID, WIFI_PASS);
  ArduinoOTA.setHostname(OTA_NAME);
  ArduinoOTA.setPassword(OTA_PASS);
  ArduinoOTA.onStart([]() { drawOtaProgress(0); });
  ArduinoOTA.onProgress([](unsigned int done, unsigned int total) {
    static int last = -1;
    int pct = done * 100 / total;
    if (pct != last) { last = pct; drawOtaProgress(pct); }
  });
  ArduinoOTA.onEnd([]() { drawOtaProgress(100); });
}

void handleWiFi(unsigned long now) {
  static bool wasConnected = false;
  static unsigned long lastTry = 0;
  bool connected = WiFi.status() == WL_CONNECTED;
  if (connected && !wasConnected) {
    if (otaReady) ArduinoOTA.end();
    ArduinoOTA.begin();
    otaReady = true;
  }
  if (!connected && now - lastTry > 15000) {
    lastTry = now;
    WiFi.disconnect();
    WiFi.begin(WIFI_SSID, WIFI_PASS);
  }
  wasConnected = connected;
  if (connected && otaReady) ArduinoOTA.handle();
}

// =====================================================================
void setup() {
  pinMode(0, INPUT_PULLUP);          // BOOT 鍵
  u8g2.setBusClock(400000);
  u8g2.begin();
  randomSeed(esp_random());
  setupWiFi();
  startScene(S_WANDER, millis());
}

void loop() {
  unsigned long now = millis();
  handleWiFi(now);

  bool btn = digitalRead(0);         // BOOT 鍵：丟球
  if (lastBtn == HIGH && btn == LOW && scene != S_FETCH && scene != S_EMPTY && scene != S_RUN_OFF)
    startScene(S_FETCH, now);
  lastBtn = btn;

  updateScene(now);
  updateMotion();
  curSprite = pickSprite(now);
  updateBall();

  u8g2.clearBuffer();
  for (int x = 0; x < 128; x += 4) px(x, 63);   // 地面
  if (scene != S_EMPTY) drawDog(now);
  drawBall();
  if (WHITE_BG) {                    // 整個畫面黑白反轉 → 白底黑線
    uint8_t* buf = u8g2.getBufferPtr();
    int n = u8g2.getBufferTileWidth() * u8g2.getBufferTileHeight() * 8;
    for (int i = 0; i < n; i++) buf[i] ^= 0xFF;
  }
  u8g2.sendBuffer();

  frame++;
  delay(10);
}

// =====================================================================
//  「汪」字點陣圖
// =====================================================================
const int WANG_W = 12, WANG_H = 12;
const unsigned char WANG_bits[] PROGMEM = {
  0x06,0x00,0xee,0x07,0x88,0x01,0x80,0x01,0x86,0x01,0x86,0x01,0xe0,0x07,0x88,0x01,0x8c,0x01,0x84,0x01,0xf6,0x0f,0x02,0x00
};
// ===== 狗狗圖片（由 AI 繪圖自動轉換，請勿手動修改）=====
const unsigned char WALK_0[] PROGMEM = {
  0x00,0x00,0x00,0x00,0x00,0x04,0x02,0x00,0x00,0x00,0x00,0x00,0x00,0x0e,0x07,0x00,0x00,0x00,0x00,
  0x00,0x00,0x9b,0x07,0x00,0x00,0x00,0x00,0x00,0x00,0xdb,0x05,0x00,0x00,0x00,0x00,0x00,0x80,0xf1,
  0x04,0x00,0x00,0x00,0x00,0x00,0x80,0xf1,0x07,0x00,0x00,0x00,0x00,0x00,0xc0,0xf5,0x07,0x00,0x00,
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  0x1e,0x00,
};
const unsigned char WALK_1[] PROGMEM = {
  0x00,0x00,0x00,0x00,0x30,0x08,0x00,0x00,0x00,0x00,0x00,0x78,0x1c,0x00,0x00,0x00,0x00,0x00,0x78,
  0x1e,0x00,0x00,0x00,0x00,0x00,0xcc,0x17,0x00,0x00,0x00,0x00,0x00,0xcc,0x37,0x00,0x00,0x00,0x00,
  0x00,0x86,0x33,0x00,0x00,0x00,0x00,0x00,0xa6,0x3f,0x00,0x00,0x00,0x00,0x00,0xa7,0x3d,0x00,0x00,
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  0xc6,0x01,0xac,0x01,0xfe,0x80,0x3f,0xfc,0x00,0xf8,0x00,0x7c,0x00,0x1f,0x00,0x00,
};
const unsigned char WALK_2[] PROGMEM = {
  0x00,0x00,0x00,0x00,0x00,0x04,0x03,0x00,0x00,0x00,0x00,0x00,0x00,0x8e,0x03,0x00,0x00,0x00,0x00,
  0x00,0x00,0x8b,0x07,0x00,0x00,0x00,0x00,0x00,0x00,0xdb,0x05,0x00,0x00,0x00,0x00,0x00,0x80,0xf1,
  0x04,0x00,0x00,0x00,0x00,0x00,0xc0,0xf1,0x05,0x00,0x00,0x00,0x00,0x00,0xc0,0xf5,0x07,0x00,0x00,
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  0x0e,0x00,
};
const unsigned char WALK_3[] PROGMEM = {
  0x00,0x00,0x00,0x00,0x80,0x61,0x00,0x00,0x00,0x00,0x00,0xc0,0xf1,0x00,0x00,0x00,0x00,0x00,0x60,
  0xf3,0x00,0x00,0x00,0x00,0x00,0x60,0xba,0x00,0x00,0x00,0x00,0x00,0x30,0x9e,0x00,0x00,0x00,0x00,
  0x00,0x30,0x9e,0x00,0x00,0x00,0x00,0x00,0x38,0xfd,0x01,0x80,0x03,0x00,0x00,0x38,0xed,0x01,0xc0,
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  0x43,0x03,0xb0,0x06,0x7f,0xd8,0x03,0xc6,0x03,0xe0,0x03,0x3e,0xf8,0x01,0xfc,0x01,
};
const unsigned char RUN_0[] PROGMEM = {
  0x00,0x00,0x00,0x00,0x00,0x00,0x00,0x03,0x00,0x00,0x00,0x00,0x00,0x00,0x80,0x87,0x03,0x00,0x00,
  0x00,0x00,0x00,0x00,0x80,0x9f,0x07,0x00,0x00,0x00,0x00,0x00,0x00,0x80,0xff,0x0f,0x00,0x00,0x00,
  0x00,0x00,0x00,0x00,0xff,0x0f,0x00,0x00,0x00,0x00,0x00,0x00,0xf0,0xef,0x1c,0x00,0x00,0x00,0x00,
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  0x01,0x00,0x00,0x00,0x00,0x00,0x00,0x00,0xf8,0x00,
};
const unsigned char RUN_1[] PROGMEM = {
  0x00,0x00,0x00,0x00,0x00,0x00,0x60,0x00,0x00,0x00,0x00,0x00,0x00,0x00,0x00,0xe0,0x01,0x00,0x00,
  0x00,0x00,0x00,0x00,0xf8,0xe7,0x03,0x00,0x00,0x00,0x00,0x00,0x00,0xf0,0xff,0x07,0x00,0x00,0x00,
  0x00,0x00,0x00,0xfc,0x7b,0x0f,0x00,0x00,0x00,0x00,0x00,0x00,0xfe,0xf7,0x1c,0x00,0x00,0x00,0x00,
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  0x00,0x00,0x00,0x78,0x00,0x00,0x00,0x00,0x00,0x00,
};
const unsigned char RUN_2[] PROGMEM = {
  0x00,0x00,0x00,0x00,0x00,0x00,0x00,0x0c,0x00,0x00,0x00,0x00,0x00,0x00,0x00,0x00,0x00,0x1e,0x00,
  0x00,0x00,0x00,0x00,0x00,0x00,0x00,0x00,0x3c,0x00,0x00,0x00,0x00,0x00,0x00,0x00,0x00,0xfe,0xff,
  0x00,0x00,0x00,0x00,0x00,0x00,0x00,0x80,0xff,0xef,0x01,0x00,0x00,0x00,0x00,0x00,0x00,0xc0,0xff,
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  0x3e,0x00,0x00,0x00,0x00,0x80,0x03,0x00,0x80,0x07,0x0c,0x00,0x00,0x00,0x00,0x00,0x00,0x00,
};
const unsigned char RUN_3[] PROGMEM = {
  0x00,0x00,0x00,0x00,0x00,0x00,0xc0,0x00,0x00,0x00,0x00,0x00,0x00,0x00,0x00,0xc0,0x01,0x00,0x00,
  0x00,0x00,0x00,0x00,0xf0,0xc3,0x03,0x00,0x00,0x00,0x00,0x00,0x00,0xf0,0xdf,0x07,0x00,0x00,0x00,
  0x00,0x00,0x00,0xe0,0xff,0x0f,0x00,0x00,0x00,0x00,0x00,0x00,0xfc,0x77,0x1c,0x00,0x00,0x00,0x00,
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  0x00,0x00,0x00,0xf0,0x07,0x00,0x00,0x00,0x00,
};
const unsigned char SIT_0[] PROGMEM = {
  0x00,0x00,0x00,0x60,0x10,0x00,0x00,0x00,0x00,0x70,0x38,0x00,0x00,0x00,0x00,0xd8,0x3c,0x00,0x00,
  0x00,0x00,0xd8,0x2e,0x00,0x00,0x00,0x00,0xcc,0x27,0x00,0x00,0x00,0x00,0x8e,0x2f,0x00,0x00,0x00,
  0x00,0xae,0x3d,0x00,0x00,0x00,0x00,0xae,0x61,0x00,0x00,0x00,0x00,0xef,0xc8,0x00,0x00,0x00,0x00,
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  0x00,0xc0,0xff,0xf0,0x03,0x00,
};
const unsigned char SIT_1[] PROGMEM = {
  0x00,0x00,0x00,0x40,0x30,0x00,0x00,0x00,0x00,0xe0,0x38,0x00,0x00,0x00,0x00,0xf0,0x78,0x00,0x00,
  0x00,0x00,0xb0,0x5d,0x00,0x00,0x00,0x00,0x98,0x4f,0x00,0x00,0x00,0x00,0x1c,0x7f,0x00,0x00,0x00,
  0x00,0x5c,0x7f,0x00,0x00,0x00,0x00,0x5c,0x63,0x00,0x00,0x00,0x00,0xfe,0x91,0x00,0x00,0x00,0x00,
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  0x00,0xf8,0xff,0xf9,0x0f,0x00,0x00,0xc0,0xff,0xf0,0x03,0x00,
};
const unsigned char BARK_0[] PROGMEM = {
  0x00,0x00,0x00,0x00,0x00,0x83,0x01,0x00,0x00,0x00,0x00,0x00,0xc7,0x01,0x00,0x00,0x00,0x00,0x80,
  0xc7,0x03,0x00,0x00,0x00,0x00,0xc0,0xec,0x02,0x00,0x00,0x00,0x00,0xc0,0x7c,0x02,0x00,0x00,0x00,
  0x00,0x60,0xf8,0x02,0x80,0x03,0x00,0x00,0x60,0xfa,0x03,0xd0,0x03,0x00,0x00,0x70,0x9a,0x03,0x38,
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  0x01,0x00,
};
const unsigned char BARK_1[] PROGMEM = {
  0x00,0x00,0x00,0x00,0xc0,0x30,0x00,0x00,0x00,0x00,0x00,0x00,0x00,0xc0,0x79,0x80,0x01,0x00,0x00,
  0x00,0x00,0x00,0xe0,0x7b,0xe0,0x03,0x00,0x00,0x00,0x00,0x00,0x60,0xff,0xfb,0x03,0x00,0x00,0x00,
  0x00,0x00,0x30,0xfe,0xfe,0x03,0x00,0x00,0x00,0x00,0x00,0x30,0xee,0xfc,0x03,0x00,0x00,0x00,0x00,
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  0xf8,0x01,0x00,0xf8,0x03,0x00,0x00,0x00,
};
const unsigned char SNIFF_0[] PROGMEM = {
  0xc0,0x00,0x00,0x00,0x00,0x00,0x00,0xe0,0x00,0x00,0x00,0x00,0x00,0x00,0xf8,0x00,0x00,0x00,0x00,
  0x00,0x00,0xdc,0x00,0x00,0x00,0x00,0x00,0x00,0xcc,0x00,0x00,0x00,0x00,0x00,0x00,0xcf,0x00,0x00,
  0x00,0x00,0x00,0x00,0xc3,0x03,0x00,0x00,0x00,0x00,0x00,0xc7,0x03,0x00,0x00,0x00,0x00,0x00,0xc1,
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  0x00,0x80,0x1f,0x00,0x00,
};
const unsigned char SNIFF_1[] PROGMEM = {
  0xc0,0x00,0x00,0x00,0x00,0x00,0x00,0xe0,0x00,0x00,0x00,0x00,0x00,0x00,0xf8,0x00,0x00,0x00,0x00,
  0x00,0x00,0xdc,0x00,0x00,0x00,0x00,0x00,0x00,0xcc,0x00,0x00,0x00,0x00,0x00,0x00,0xc6,0x01,0x00,
  0x00,0x00,0x00,0x00,0xc7,0x03,0x00,0x00,0x00,0x00,0x00,0xc7,0x03,0x00,0x00,0x00,0x00,0x00,0xc7,
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  0x00,0x80,0x3f,0x00,0x00,
};
const unsigned char SLEEP_0[] PROGMEM = {
  0x00,0x00,0x00,0x00,0x30,0x00,0x00,0x00,0x00,0x00,0x00,0x38,0xe0,0x00,0x00,0x00,0x00,0x00,0x7c,
  0xf0,0x00,0x00,0x00,0x00,0x00,0x66,0xf8,0x00,0x00,0x00,0x00,0x00,0xe6,0xbc,0x00,0x00,0x00,0x00,
  0x00,0xe7,0x9e,0x00,0x00,0x00,0x00,0x00,0xc3,0x9f,0x00,0x00,0x00,0xff,0x87,0xd3,0xff,0x00,0x00,
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  0x00,0x80,0x0f,0x03,0x00,0xf0,0x07,0x00,
};
const unsigned char SLEEP_1[] PROGMEM = {
  0x00,0x00,0x00,0x00,0x80,0x00,0x00,0x00,0x00,0x00,0x00,0x00,0xc0,0x01,0x03,0x00,0x00,0x00,0x00,
  0x00,0xe0,0x83,0x07,0x00,0x00,0x00,0x00,0x00,0xb0,0xe3,0x07,0x00,0x00,0x00,0x00,0x00,0x18,0xf7,
  0x06,0x00,0x00,0x00,0x00,0x00,0x18,0xf7,0x06,0x00,0x00,0x00,0x00,0x00,0x1c,0xff,0x06,0x00,0x00,
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  0xff,0x34,0x00,0x00,0x00,0x00,0x00,0x00,0xc0,0x1f,0x00,0x00,
};

const Sprite SPRITES[] = {
  // 寬  高  中心X 嘴X  嘴Y  資料
  { 57, 43, 30,  25, -26, WALK_0 },   // WALK 1
  { 52, 43, 25,  25, -25, WALK_1 },   // WALK 2
  { 57, 43, 30,  25, -26, WALK_2 },   // WALK 3
  { 55, 43, 28,  25, -26, WALK_3 },   // WALK 4
  { 69, 37, 36,  30, -21, RUN_0 },   // RUN 1
  { 67, 37, 35,  30, -21, RUN_1 },   // RUN 2
  { 73, 36, 41,  30, -20, RUN_2 },   // RUN 3
  { 68, 39, 36,  30, -23, RUN_3 },   // RUN 4
  { 44, 39, 23,  19, -23, SIT_0 },   // SIT 1
  { 45, 40, 24,  19, -23, SIT_1 },   // SIT 2
  { 56, 41, 29,  25, -24, BARK_0 },   // BARK 1
  { 68, 41, 31,  25, -33, BARK_1 },   // BARK 2
  { 52, 36, 27,  23,  -2, SNIFF_0 },   // SNIFF 1
  { 54, 36, 28,  23,  -3, SNIFF_1 },   // SNIFF 2
  { 54, 31, 27,  24, -10, SLEEP_0 },   // SLEEP 1
  { 57, 30, 30,  24,  -9, SLEEP_1 },   // SLEEP 2
};
