/*
 * 趕雞的心 Heart Chasing Hen（OLED 動畫）
 * 硬體：ESP32 + 1.3 吋 OLED (SH1106, I2C)
 * 接線：VCC→3V3、GND→GND、SCL→D22、SDA→D21
 *
 * 動畫流程（無限循環）：
 *   1. 心拿著樹枝追著雞，從左邊跑進畫面
 *   2. 在中間原地狂奔約 4 秒：一上一下跳、距離忽遠忽近、背景有速度線
 *   3. 從右邊跑出畫面，停一下再重來
 *   下方「趕雞的心」四個字會像波浪一樣輪流跳動
 *
 * 圖片已轉成 OLED 用的點陣圖（檔案最下方的陣列），不需要額外檔案或字型。
 * 若畫面右側有雜點，把下面的 SH1106 改成 SSD1306
 */

#include <U8g2lib.h>
#include <Wire.h>
#include <math.h>

U8G2_SH1106_128X64_NONAME_F_HW_I2C u8g2(U8G2_R0, U8X8_PIN_NONE);

// ===== 點陣圖資料在檔案最下方，這裡先宣告 =====
extern const int HEART_W, HEART_H, HEN_W, HEN_H, TITLE_W, TITLE_H;
extern const unsigned char HEART_bits[], HEN_bits[], TITLE_bits[];

// ===== 版面設定 =====
const int SCENE_Y  = 1;    // 圖案上緣
const int TITLE_Y  = 50;   // 文字上緣
const int HEN_DX   = 47;   // 雞相對於心的水平位置
const int HEN_DY   = 15;   // 雞相對於心的垂直位置
const int GROUP_W  = 92;   // 整組圖案寬度
const int CENTER_X = (128 - GROUP_W) / 2;
const int CHAR_W   = 14;   // 每個字的寬度

// ===== 動畫狀態 =====
enum Phase { ENTER, CHASE, EXIT, PAUSE };
Phase phase = ENTER;
float groupX = -GROUP_W;
unsigned long phaseStart = 0;
unsigned long frame = 0;

// 畫點陣圖（自己逐點畫，圖案跑出螢幕邊界也不會出錯）
// colFrom / colTo：只畫其中幾欄，用來把文字拆成一個一個字
void blit(const unsigned char* bits, int w, int h, int x, int y,
          int colFrom = 0, int colTo = -1) {
  if (colTo < 0) colTo = w;
  int bytesPerRow = (w + 7) / 8;
  for (int j = 0; j < h; j++) {
    int yy = y + j;
    if (yy < 0 || yy > 63) continue;
    for (int i = colFrom; i < colTo; i++) {
      int xx = x + i;
      if (xx < 0 || xx > 127) continue;
      uint8_t b = pgm_read_byte(&bits[j * bytesPerRow + i / 8]);
      if (b & (1 << (i % 8))) u8g2.drawPixel(xx, yy);
    }
  }
}

// 背景速度線：往左流動，表現「跑很快」
void drawSpeedLines() {
  static const int rows[] = {8, 20, 33, 44};
  for (int k = 0; k < 4; k++) {
    int len = 6 + (k * 5) % 9;
    int x = 127 - (int)((frame * 6 + k * 37) % 150);
    u8g2.drawHLine(x < 0 ? 0 : x, rows[k], len);
  }
}

void drawScene() {
  // 跑步時一上一下跳；心和雞的節奏錯開
  float t = frame * 0.35f;
  int heartBounce = -(int)(fabsf(sinf(t)) * 3);
  int henBounce   = -(int)(fabsf(sinf(t + 1.2f)) * 3);

  // 中段追逐時，雞忽遠忽近
  int henGap = 0;
  if (phase == CHASE) henGap = (int)(sinf(frame * 0.08f) * 4);

  int x = (int)groupX;
  blit(HEART_bits, HEART_W, HEART_H, x, SCENE_Y + heartBounce);
  blit(HEN_bits, HEN_W, HEN_H, x + HEN_DX + henGap, SCENE_Y + HEN_DY + henBounce);
}

void drawTitle() {
  int x0 = (128 - TITLE_W) / 2;
  int chars = TITLE_W / CHAR_W;
  for (int c = 0; c < chars; c++) {
    // 四個字輪流往上跳一下，像波浪
    float s = sinf(frame * 0.15f - c * 0.9f);
    int dy = s > 0.6f ? -1 : 0;
    blit(TITLE_bits, TITLE_W, TITLE_H, x0, TITLE_Y + dy, c * CHAR_W, (c + 1) * CHAR_W);
  }
}

void setup() {
  u8g2.setBusClock(400000);   // I2C 加速，動畫才順
  u8g2.begin();
  phaseStart = millis();
}

void loop() {
  unsigned long now = millis();
  unsigned long elapsed = now - phaseStart;

  switch (phase) {
    case ENTER:   // 從左邊跑進來
      groupX += 2.0f;
      if (groupX >= CENTER_X) { groupX = CENTER_X; phase = CHASE; phaseStart = now; }
      break;
    case CHASE:   // 原地狂奔
      if (elapsed > 4000) { phase = EXIT; phaseStart = now; }
      break;
    case EXIT:    // 從右邊跑出去
      groupX += 2.5f;
      if (groupX > 128) { phase = PAUSE; phaseStart = now; }
      break;
    case PAUSE:   // 空場停一下
      if (elapsed > 600) { groupX = -GROUP_W; phase = ENTER; phaseStart = now; }
      break;
  }

  u8g2.clearBuffer();
  if (phase == CHASE) drawSpeedLines();
  if (phase != PAUSE) drawScene();
  drawTitle();
  u8g2.sendBuffer();

  frame++;
  delay(15);
}

// =====================================================================
//  點陣圖資料（由原圖自動轉換，請勿手動修改）
// =====================================================================
const int HEART_W = 67, HEART_H = 47;
const unsigned char HEART_bits[] PROGMEM = {
  0x00,0x00,0x00,0x00,0x00,0x00,0x04,0x00,0x00,0x00,0x00,0x00,0x00,0x00,0x00,0x06,0x00,0x00,
  0x00,0x00,0x00,0x00,0x00,0x00,0x07,0x00,0x00,0x00,0x00,0x00,0x00,0x00,0x00,0x03,0x00,0x00,
  0x00,0x00,0x00,0x00,0xc0,0x07,0x70,0x00,0x00,0x00,0x00,0x40,0x00,0xf0,0x1f,0x38,0x00,0x00,
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  0x00,0x00,0x00,0x00,0x30,0x00,0x00,0x00,0x00
};
const int HEN_W = 45, HEN_H = 33;
const unsigned char HEN_bits[] PROGMEM = {
  0x00,0x00,0x00,0xe0,0x01,0x00,0x00,0x00,0x00,0xe0,0x03,0x00,0x00,0x00,0x00,0xff,0x03,0x02,
  0x00,0x00,0x00,0xff,0x03,0x03,0x00,0x00,0x80,0xff,0x83,0x03,0x00,0x00,0x80,0xff,0x87,0x00,
  0x00,0x00,0x80,0xff,0x0f,0x00,0x00,0x00,0xc0,0x0f,0x1c,0x1e,0x00,0x00,0xc0,0x07,0x18,0x0e,
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  0x00,0x1e,0x00,0x00,0x07,0x00,0x00,0x1a,0x00,0x00,0x03,0x00,0x00,0x18,0x00,0x00,0x00,0x00
};
const int TITLE_W = 56, TITLE_H = 14;
const unsigned char TITLE_bits[] PROGMEM = {
  0x00,0x00,0x00,0x00,0x00,0x00,0x00,0x90,0x0f,0x5c,0x81,0x11,0x80,0x01,0xfc,0x08,0x4f,0x81,
  0x19,0x80,0x03,0x98,0x0f,0x75,0xc3,0xfb,0x00,0x07,0xb8,0x0f,0xe7,0x47,0x9e,0x00,0x06,0x7e,
  0x0f,0x7b,0x41,0x8e,0xc0,0x10,0x90,0x0f,0xef,0x43,0x96,0xf0,0x30,0x14,0x02,0x7e,0xc1,0x93,
  0xf0,0x30,0xf4,0x1f,0x7f,0x41,0xb2,0xd0,0x20,0x1c,0x82,0xff,0x43,0xa2,0xd0,0x68,0x1c,0x02,
  0x66,0x41,0x82,0xd0,0x38,0x3e,0x02,0xff,0xc7,0xc3,0x80,0x09,0xe6,0x0f,0x71,0x40,0x70,0x80,
  0x0f,0x00,0x00,0x00,0x00,0x00,0x00,0x00
};
